/*
 * DS28E07 + DS2430A (EEPROM 1-Wire) - ĐỌC / GHI MÃ MỚI / KHÔI PHỤC MÃ CŨ / QUẢN LÝ DANH SÁCH THIẾT BỊ MỚI
 * ESP32-S3 + màn hình TFT 2.0 inch ILI9225 (176x220) + 2 nút nhấn
 * TỰ NHẬN DIỆN LOẠI CHIP theo family code trong ROM ID:  0x2D = DS28E07,  0x14 = DS2430A
 * Hiển thị TIẾNG VIỆT CÓ DẤU (font bitmap Unifont 8x16 nhúng sẵn trong file, không cần thư viện font)
 *
 * Menu:
 *   1. ĐỌC THIẾT BỊ   : nhận diện chip, đọc ROM ID + 16 byte dữ liệu (+ vùng admin nếu là DS28E07),
 *                       nhận diện MÃ MỚI / MÃ CŨ. 16 byte vừa đọc được LƯU làm "MÃ CŨ" (trừ khi chip đang là MÃ MỚI).
 *   2. GHI MÃ MỚI     : chọn 1 thiết bị trong danh sách mã mới, ghi ĐÚNG 16 byte của thiết bị đó vào chip.
 *   3. GHI MÃ MỚI RANDOM: như mục 2 nhưng BYTE CUỐI (byte thứ 16) RANDOM mỗi lần ghi.
 *                       (cả mục 2 và 3: trước khi ghi, mã hiện tại của chip được lưu làm "MÃ CŨ")
 *   4. KHÔI PHỤC MÃ CŨ: ghi lại đúng 16 byte đã lưu. Chỉ chạy khi ROM ID của chip khớp với chip đã backup.
 *   5. THIẾT BỊ MỚI   : quản lý danh sách thiết bị mã mới (tối đa 8, lưu NVS): thêm (đọc từ chip đang cắm) / xóa.
 *   6. CÀI ĐẶT        : chỉnh hướng màn hình, lật dọc/ngang, đảo màu (lưu vào bộ nhớ)
 *
 * Hai loại chip đều lưu 16 byte dữ liệu ở 0x00..0x0F nên dùng chung danh sách mã mới và mã cũ:
 *   DS28E07 (0x2D): 128 byte, địa chỉ 2 byte, ghi từng hàng 8 byte qua scratchpad có CRC16, có vùng admin 0x80..0x87.
 *   DS2430A (0x14): 32 byte, địa chỉ 1 byte, Copy Scratchpad luôn chép cả 32 byte nên tool đọc nguyên 32 byte,
 *                   chỉ thay 0x00..0x0F rồi ghi lại, 0x10..0x1F giữ nguyên. Không đụng application register (OTP).
 *
 * Khởi động: hiện logo "TUIOT" 3 giây có hiệu ứng (hàm showSplash), sau đó vào menu.
 *
 * Nút nhấn:
 *   NAV (GPIO5): bấm = xuống / chuyển lựa chọn; hết mục cuối sẽ quay về mục đầu
 *   SEL (GPIO6): chọn / xác nhận
 *   Giữ SEL lúc cấp nguồn = khôi phục cài đặt màn hình về mặc định
 *
 * Đấu dây:
 *   1-Wire : GPIO4 (IO của chip) + điện trở kéo lên 1k..2.2k tới 3V3 (BẮT BUỘC), GND chung
 *   TFT    : SCK=12  MOSI(SDI)=11  CS=10  DC(RS)=9  RST=8  VCC=3V3  GND  (không dùng chân LED)
 *   Nút    : NAV=GPIO5 -> GND,  SEL=GPIO6 -> GND (INPUT_PULLUP)
 *
 * Thư viện: OneWire (Paul Stoffregen), TFT_22_ILI9225 (Nkawu)
 *
 * An toàn:
 *   - Chỉ ghi 16 byte ở 0x00..0x0F. KHÔNG bao giờ ghi vùng admin 0x80..0x87 (DS28E07)
 *     và application register (DS2430A).
 *   - DS28E07: dừng nếu page 0 bị khóa (0x80 = 55) hoặc EPROM mode (0x80 = AA).
 *   - Hiện dữ liệu cũ / mới, bắt buộc xác nhận trước khi ghi, ghi xong đọc lại kiểm tra.
 *   - Dữ liệu cũ trước khi ghi được in ra Serial (115200) và lưu vào NVS để khôi phục.
 *   - Không lưu đè MÃ CŨ nếu chip đang chứa MÃ MỚI (tránh mất mã gốc).
 *
 * Khi ghi, chân GPIO4 tự kéo mức cao mạnh (strong pullup) khoảng 20 ms để cấp điện cho chip lập trình EEPROM
 * (datasheet DS2430A yêu cầu điều này khi chạy ở điện áp thấp như 3.3V). Phải giữ tiếp xúc ổn định suốt lúc ghi.
 *
 * Font: GNU Unifont (SIL OFL 1.1 / GPLv2+ với font exception), chỉ nhúng các ký tự cần dùng.
 */

#include <SPI.h>
#include <Preferences.h>
#include <esp_random.h>
#include "TFT_22_ILI9225.h"
#include <OneWire.h>

// Sự kiện nút nhấn và loại chip. PHẢI khai báo trước mọi hàm để Arduino IDE tự tạo prototype không bị lỗi
enum Event { EV_NONE, EV_NEXT, EV_SELECT };
enum ChipType { CT_NONE, CT_28E07, CT_2430A };

// ---------------- Cấu hình chân ----------------
constexpr uint8_t PIN_1WIRE = 4;
constexpr uint8_t PIN_NAV   = 5;
constexpr uint8_t PIN_SEL   = 6;

constexpr int8_t  PIN_TFT_SCK = 12;
constexpr int8_t  PIN_TFT_SDI = 11;   // MOSI
constexpr int8_t  PIN_TFT_CS  = 10;
constexpr int8_t  PIN_TFT_RS  = 9;    // DC
constexpr int8_t  PIN_TFT_RST = 8;

// Màn hình nằm ngang 220x176 (orientation 1 hoặc 3)
constexpr int SCR_W  = 220;
constexpr int SCR_H  = 176;
constexpr int HDR_H  = 22;    // thanh tiêu đề
constexpr int FOOT_H = 18;    // thanh hướng dẫn phía dưới

// Cài đặt màn hình mặc định (chỉnh được trong menu CÀI ĐẶT, lưu vào NVS)
uint8_t g_orient = 1;
bool    g_flipX  = false;
bool    g_flipY  = true;      // ảnh chụp cho thấy orientation 1 bị lật dọc -> mặc định bật
bool    g_inv    = false;

// ---------------- Cấu hình chip ----------------
constexpr uint8_t  CMD_READ_MEMORY = 0xF0;
constexpr uint8_t  CMD_WRITE_SP    = 0x0F;   // Write Scratchpad (cả 2 loại chip)
constexpr uint8_t  CMD_READ_SP     = 0xAA;   // Read Scratchpad
constexpr uint8_t  CMD_COPY_SP     = 0x55;   // Copy Scratchpad
constexpr uint8_t  KEY_COPY_2430A  = 0xA5;   // validation key sau lệnh Copy Scratchpad của DS2430A
constexpr uint8_t  FAMILY_28E07    = 0x2D;
constexpr uint8_t  FAMILY_2430A    = 0x14;
constexpr uint16_t USER_LEN        = 0x80;   // DS28E07: 128 byte user memory
constexpr uint16_t DUMP_LEN        = 0x88;   // buffer lớn nhất: DS28E07 0x00..0x87 (user + admin)
constexpr uint16_t PAGE_2430A      = 0x20;   // DS2430A: 32 byte
constexpr uint16_t ADDR_REVISION   = 0x00FF; // chỉ DS28E07
constexpr uint8_t  MAX_TRIES       = 3;

constexpr uint16_t WRITE_ADDR      = 0x0000;
constexpr uint16_t WRITE_LEN       = 16;      // phải là bội của 8
constexpr uint16_t T_PROG_MS       = 20;

// Mã MỚI mặc định (pod mới, ROM 2D DF 6D 2D 4D 00 00 06). Lần chạy đầu tiên được nạp làm thiết bị số 1.
// 15 byte đầu cố định, BYTE CUỐI (0x3D) chỉ là giá trị mẫu - khi ghi random sẽ được thay bằng số ngẫu nhiên.
const uint8_t NEW_DATA[WRITE_LEN] = {
  0x00, 0xC3, 0x66, 0xCC, 0x51, 0x9A, 0x4E, 0xDE,
  0x11, 0x20, 0x1B, 0x22, 0xD4, 0xD1, 0xA8, 0x3D
};

// MÃ CŨ không còn là mảng cố định: nó là 16 byte đọc được từ chip, lưu trong NVS (xem phần BACKUP).

// ---------------- Đối tượng ----------------
OneWire ds(PIN_1WIRE);
TFT_22_ILI9225 tft(PIN_TFT_RST, PIN_TFT_RS, PIN_TFT_CS, 0);   // led = 0: không dùng chân đèn nền
Preferences prefs;

// Màu RGB565 - giao diện SÁNG (nền trắng, chữ đen)
constexpr uint16_t C_WHITE = 0xFFFF;
constexpr uint16_t C_BG    = 0xFFFF;
constexpr uint16_t C_TEXT  = 0x0000;
constexpr uint16_t C_HEAD  = 0x001F;
constexpr uint16_t C_DIM   = 0x4208;
constexpr uint16_t C_BAR   = 0xC618;
constexpr uint16_t C_SEL   = 0xFD20;
constexpr uint16_t C_ACC   = 0x001F;
constexpr uint16_t C_OK    = 0x0400;
constexpr uint16_t C_ERR   = 0xC000;
constexpr uint16_t C_WARN  = 0xC200;

const char *g_err = "";

// ---- FONT UNIFONT 8x16 (tu dong tao: 180 ky tu) ----
constexpr int VN_N = 180;
const uint16_t VN_CP[VN_N] = {
  0x0020, 0x0021, 0x0022, 0x0023, 0x0024, 0x0025, 0x0026, 0x0027, 0x0028, 0x0029, 0x002A, 0x002B,
  0x002C, 0x002D, 0x002E, 0x002F, 0x0030, 0x0031, 0x0032, 0x0033, 0x0034, 0x0035, 0x0036, 0x0037,
  0x0038, 0x0039, 0x003A, 0x003B, 0x003C, 0x003D, 0x003E, 0x003F, 0x0040, 0x0041, 0x0042, 0x0043,
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  0x1EDD, 0x1EDF, 0x1EE3, 0x1EE4, 0x1EE5, 0x1EE6, 0x1EE7, 0x1EE8, 0x1EEB, 0x1EED, 0x1EEF, 0x1EF1,
};
const uint8_t VN_GLYPH[VN_N][16] = {
  {0x00,0x00,0x00,0x00,0x00,0x00,0x00,0x00,0x00,0x00,0x00,0x00,0x00,0x00,0x00,0x00}, // U+0020 ' '
  {0x00,0x00,0x00,0x00,0x08,0x08,0x08,0x08,0x08,0x08,0x08,0x00,0x08,0x08,0x00,0x00}, // U+0021 '!'
  {0x00,0x00,0x22,0x22,0x22,0x22,0x00,0x00,0x00,0x00,0x00,0x00,0x00,0x00,0x00,0x00}, // U+0022 '"'
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  {0x00,0x00,0x00,0x00,0x02,0x01,0x45,0x46,0x44,0x44,0x44,0x44,0x4C,0x34,0x00,0x10}, // U+1EF1 ự
};

// ================= CÀI ĐẶT MÀN HÌNH (NVS) =================
void loadSettings() {
  prefs.begin("tftcfg", false);
  g_orient = prefs.getUChar("o", 1);
  g_flipX  = prefs.getBool("fx", false);
  g_flipY  = prefs.getBool("fy", true);
  g_inv    = prefs.getBool("inv", false);
  if (g_orient != 1 && g_orient != 3) g_orient = 1;
}

void saveSettings() {
  prefs.putUChar("o", g_orient);
  prefs.putBool("fx", g_flipX);
  prefs.putBool("fy", g_flipY);
  prefs.putBool("inv", g_inv);
}

void applyDisplay() {
  tft.setOrientation(g_orient);
  tft.invert(g_inv);
}

// ================= NÚT NHẤN =================
bool     navDown = false, selDown = false;
uint32_t navEdge = 0, selEdge = 0;

Event pollButtons() {
  uint32_t now = millis();

  bool n = digitalRead(PIN_NAV) == LOW;
  if (n && !navDown && now - navEdge > 30) {
    navDown = true; navEdge = now;
  } else if (!n && navDown && now - navEdge > 30) {
    navDown = false; navEdge = now;
    return EV_NEXT;
  }

  bool s = digitalRead(PIN_SEL) == LOW;
  if (s && !selDown && now - selEdge > 30) {
    selDown = true; selEdge = now;
  } else if (!s && selDown && now - selEdge > 30) {
    selDown = false; selEdge = now;
    return EV_SELECT;
  }
  return EV_NONE;
}

void waitAnyButton() {
  while (true) {
    if (pollButtons() != EV_NONE) return;
    delay(5);
  }
}

// ================= TIỆN ÍCH IN =================
void printHexLine(const uint8_t *b, size_t len) {
  for (size_t i = 0; i < len; i++) Serial.printf("%02X ", b[i]);
}

const char *describeProtect(uint8_t v) {
  if (v == 0x55) return "KHÓA GHI";
  if (v == 0xAA) return "EPROM mode";
  return "mở";
}

// ================= BACKUP MÃ CŨ (NVS) =================
// MÃ CŨ = 16 byte đọc được từ chip, lưu cùng ROM ID để chỉ khôi phục đúng chip đó.
bool    g_hasBk = false;
uint8_t g_bkRom[8];
uint8_t g_bkData[WRITE_LEN];

void loadBackup() {
  g_hasBk = (prefs.getBytesLength("bkdat") == WRITE_LEN && prefs.getBytesLength("bkrom") == 8);
  if (g_hasBk) {
    prefs.getBytes("bkrom", g_bkRom, 8);
    prefs.getBytes("bkdat", g_bkData, WRITE_LEN);
  }
}

// ================= DANH SÁCH THIẾT BỊ MÃ MỚI (NVS) =================
constexpr int MAX_DEV = 8;
uint8_t g_dev[MAX_DEV][WRITE_LEN];
int     g_nDev = 0;

void saveDevices() {
  prefs.putUChar("ndev", (uint8_t)g_nDev);
  if (g_nDev > 0) prefs.putBytes("devs", g_dev, g_nDev * WRITE_LEN);
  else            prefs.remove("devs");
}

void loadDevices() {
  uint8_t n = prefs.getUChar("ndev", 255);
  if (n == 255) {                              // lần chạy đầu: nạp NEW_DATA làm thiết bị số 1
    memcpy(g_dev[0], NEW_DATA, WRITE_LEN);
    g_nDev = 1;
    saveDevices();
    return;
  }
  if (n > MAX_DEV) n = 0;
  if (n > 0 && prefs.getBytesLength("devs") == (size_t)n * WRITE_LEN) {
    prefs.getBytes("devs", g_dev, n * WRITE_LEN);
    g_nDev = n;
  } else {
    g_nDev = 0;
  }
}

// MÃ MỚI: 15 byte đầu khớp BẤT KỲ thiết bị nào trong danh sách (bỏ qua byte cuối - random)
int findNewIdx(const uint8_t *d) {
  for (int i = 0; i < g_nDev; i++)
    if (memcmp(d, g_dev[i], WRITE_LEN - 1) == 0) return i;
  return -1;
}

bool isNewCode(const uint8_t *d) {
  return findNewIdx(d) >= 0;
}

// Lưu 16 byte vừa đọc làm "mã cũ". Không lưu nếu chip đang là MÃ MỚI (tránh mất mã gốc).
bool saveBackup(const uint8_t *rom, const uint8_t *data) {
  if (isNewCode(data)) return false;
  memcpy(g_bkRom, rom, 8);
  memcpy(g_bkData, data, WRITE_LEN);
  prefs.putBytes("bkrom", g_bkRom, 8);
  prefs.putBytes("bkdat", g_bkData, WRITE_LEN);
  g_hasBk = true;
  Serial.print("Đã lưu MÃ CŨ: "); printHexLine(g_bkData, WRITE_LEN); Serial.println();
  return true;
}

const char *nameOf(const uint8_t *d) {
  static char nb[16];
  int i = findNewIdx(d);
  if (i >= 0) { snprintf(nb, sizeof(nb), "MÃ MỚI %d", i + 1); return nb; }
  if (g_hasBk && memcmp(d, g_bkData, WRITE_LEN) == 0) return "MÃ CŨ";
  return "KHÁC";
}

bool fail(const char *msg) {
  g_err = msg;
  Serial.println(msg);
  return false;
}

// ================= TFT: hình chữ nhật có lật X/Y bằng phần mềm =================
// Toạ độ (x,y) là toạ độ logic, gốc trên-trái. Nếu màn hình bị lật thì bật g_flipX / g_flipY.
void fillR(int x, int y, int w, int h, uint16_t col) {
  int px = g_flipX ? SCR_W - x - w : x;
  int py = g_flipY ? SCR_H - y - h : y;
  tft.fillRectangle(px, py, px + w - 1, py + h - 1, col);
}

void strokeR(int x, int y, int w, int h, uint16_t col) {
  int px = g_flipX ? SCR_W - x - w : x;
  int py = g_flipY ? SCR_H - y - h : y;
  tft.drawRectangle(px, py, px + w - 1, py + h - 1, col);
}

// ================= TFT: chữ tiếng Việt (UTF-8) bằng font bitmap 8x16 =================
const uint8_t *vnGlyph(uint16_t cp) {
  int lo = 0, hi = VN_N - 1;
  while (lo <= hi) {
    int mid = (lo + hi) / 2;
    uint16_t v = VN_CP[mid];
    if (v == cp) return VN_GLYPH[mid];
    if (v < cp) lo = mid + 1; else hi = mid - 1;
  }
  return nullptr;
}

// Đọc 1 ký tự UTF-8 (tối đa 3 byte), tăng con trỏ
uint16_t nextCp(const char *&s) {
  uint8_t c = (uint8_t)*s++;
  if (c < 0x80) return c;
  if ((c & 0xE0) == 0xC0 && s[0]) {
    uint16_t cp = (uint16_t)((c & 0x1F) << 6) | (uint16_t)(s[0] & 0x3F);
    s += 1;
    return cp;
  }
  if ((c & 0xF0) == 0xE0 && s[0] && s[1]) {
    uint16_t cp = (uint16_t)((c & 0x0F) << 12) | (uint16_t)((s[0] & 0x3F) << 6) | (uint16_t)(s[1] & 0x3F);
    s += 2;
    return cp;
  }
  return '?';
}

int txtLen(const char *s) {            // số ký tự (không phải số byte)
  int n = 0;
  while (*s) { nextCp(s); n++; }
  return n;
}

void drawGlyph(int x, int y, const uint8_t *g, uint16_t col, int sc) {
  if (x < 0 || y < 0 || x + 8 * sc > SCR_W || y + 16 * sc > SCR_H) return;   // chống tràn màn hình
  for (int r = 0; r < 16; r++) {
    uint8_t b = g[r];
    if (!b) continue;
    int c = 0;
    while (c < 8) {
      if (b & (0x80 >> c)) {
        int st = c;
        while (c < 8 && (b & (0x80 >> c))) c++;
        fillR(x + st * sc, y + r * sc, (c - st) * sc, sc, col);
      } else {
        c++;
      }
    }
  }
}

// Vẽ chuỗi UTF-8, (x,y) là góc trên-trái, mỗi ký tự rộng 8*sc, cao 16*sc. Nền trong suốt.
void txtS(int x, int y, const char *s, uint16_t col, int sc) {
  while (*s) {
    uint16_t cp = nextCp(s);
    if (cp != ' ') {
      const uint8_t *g = vnGlyph(cp);
      if (!g) g = vnGlyph('?');
      if (g) drawGlyph(x, y, g, col, sc);
    }
    x += 8 * sc;
  }
}

void txt(int x, int y, const char *s, uint16_t col) {
  txtS(x, y, s, col, 1);
}

// ================= TFT: khung màn hình =================
void drawScreen(const char *title, const char *hint) {
  fillR(0, 0, SCR_W, SCR_H, C_BG);
  fillR(0, 0, SCR_W, HDR_H, C_HEAD);
  txt(6, 3, title, C_WHITE);
  fillR(0, SCR_H - FOOT_H, SCR_W, FOOT_H, C_BAR);
  txt(4, SCR_H - FOOT_H + 1, hint, C_DIM);
}

void clearBody() {
  fillR(0, HDR_H, SCR_W, SCR_H - HDR_H - FOOT_H, C_BG);
}

// 16 byte thành 2 dòng, mỗi dòng 8 byte chia 2 nhóm: "00C366CC 519A4EDE"
void drawHex16(int x, int y, const uint8_t *d, uint16_t col) {
  char b[24];
  for (int r = 0; r < 2; r++) {
    const uint8_t *p = d + r * 8;
    snprintf(b, sizeof(b), "%02X%02X%02X%02X %02X%02X%02X%02X",
             p[0], p[1], p[2], p[3], p[4], p[5], p[6], p[7]);
    txt(x, y + r * 16, b, col);
  }
}

void drawRom(int y, const uint8_t *rom) {
  char b[40];
  snprintf(b, sizeof(b), "ROM %02X %02X %02X %02X %02X %02X %02X %02X",
           rom[0], rom[1], rom[2], rom[3], rom[4], rom[5], rom[6], rom[7]);
  txt(2, y, b, C_WARN);
}

void showResult(bool ok, const char *l1, const char *l2) {
  clearBody();
  int sc = (txtLen(l1) * 16 <= SCR_W - 12) ? 2 : 1;      // chữ to nếu đủ chỗ
  txtS(6, 34, l1, ok ? C_OK : C_ERR, sc);
  txt(6, 34 + sc * 16 + 8, l2, C_TEXT);
  txt(6, SCR_H - FOOT_H - 20, "Bấm SEL để quay lại", C_DIM);
}

// ================= 1-WIRE CƠ BẢN =================
ChipType chipTypeOf(const uint8_t *rom) {
  if (rom[0] == FAMILY_28E07) return CT_28E07;
  if (rom[0] == FAMILY_2430A) return CT_2430A;
  return CT_NONE;
}

const char *chipName(ChipType t) {
  if (t == CT_28E07) return "DS28E07";
  if (t == CT_2430A) return "DS2430A";
  return "?";
}

// Số byte cần đọc/kiểm tra của từng loại chip
uint16_t dumpLen(ChipType t) {
  return (t == CT_2430A) ? PAGE_2430A : DUMP_LEN;
}

// Read Memory (F0h): DS28E07 gửi TA1 + TA2 (2 byte địa chỉ), DS2430A chỉ gửi 1 byte địa chỉ
bool readMemory(ChipType t, const uint8_t *rom, uint16_t addr, uint8_t *buf, size_t len) {
  if (!ds.reset()) return false;
  ds.select(rom);
  ds.write(CMD_READ_MEMORY);
  ds.write(addr & 0xFF);                    // TA1
  if (t == CT_28E07) ds.write(addr >> 8);   // TA2 (chỉ DS28E07)
  for (size_t i = 0; i < len; i++) buf[i] = ds.read();
  ds.reset();
  return true;
}

bool findChip(uint8_t *rom) {
  for (uint8_t t = 1; t <= MAX_TRIES; t++) {
    ds.reset_search();
    if (ds.search(rom)) {
      ds.reset_search();
      if (OneWire::crc8(rom, 7) == rom[7]) return true;
      Serial.printf("  lần thử %u: ROM ID sai CRC\n", t);
    } else {
      ds.reset_search();
      Serial.printf("  lần thử %u: không thấy chip\n", t);
    }
    delay(30);
  }
  g_err = "Kiểm tra dây và trở kéo";
  Serial.println("[LỖI] Không đọc được ROM ID. Kiểm tra tiếp xúc, điện trở kéo lên 1k-2.2k.");
  return false;
}

// Tìm chip và nhận diện loại. Nếu lỗi / chip lạ thì tự hiện màn hình báo lỗi, chờ bấm nút rồi trả về false.
bool findSupported(uint8_t *rom, ChipType &ct) {
  if (!findChip(rom)) { showResult(false, "KHÔNG CÓ CHIP", g_err); waitAnyButton(); return false; }
  ct = chipTypeOf(rom);
  if (ct == CT_NONE) {
    Serial.printf("[LỖI] Family code 0x%02X không hỗ trợ (chỉ 0x2D = DS28E07, 0x14 = DS2430A).\n", rom[0]);
    showResult(false, "CHIP LẠ", "Chỉ hỗ trợ 2D và 14");
    waitAnyButton();
    return false;
  }
  return true;
}

// Đọc hai lượt (dumpLen byte), phải trùng nhau
bool readStable(ChipType t, const uint8_t *rom, uint8_t *out) {
  static uint8_t b[DUMP_LEN];
  const uint16_t n = dumpLen(t);
  for (uint8_t k = 1; k <= MAX_TRIES; k++) {
    if (!readMemory(t, rom, 0x0000, out, n) || !readMemory(t, rom, 0x0000, b, n)) {
      delay(50);
      continue;
    }
    if (memcmp(out, b, n) == 0) return true;
    delay(50);
  }
  g_err = "Dữ liệu không ổn định";
  Serial.println("[LỖI] Dữ liệu không ổn định. Kiểm tra tiếp xúc.");
  return false;
}

// DS28E07: ghi 1 hàng 8 byte qua scratchpad: Write SP -> Read SP (kiểm tra) -> Copy SP
bool writeRow(const uint8_t *rom, uint16_t addr, const uint8_t *data) {
  if (addr & 7)        return fail("Địa chỉ không chia hết 8");
  if (addr + 8 > 0x80) return fail("Ngoài vùng user memory");
  const uint8_t ta1 = addr & 0xFF, ta2 = addr >> 8;
  uint8_t crc[2];

  uint8_t ws[3 + 8] = { CMD_WRITE_SP, ta1, ta2 };
  memcpy(ws + 3, data, 8);
  if (!ds.reset()) return fail("Mất presence (Write SP)");
  ds.select(rom);
  for (uint8_t i = 0; i < sizeof(ws); i++) ds.write(ws[i]);
  crc[0] = ds.read();
  crc[1] = ds.read();
  if (!OneWire::check_crc16(ws, sizeof(ws), crc)) return fail("CRC16 sai (Write SP)");

  uint8_t rs[1 + 3 + 8];
  rs[0] = CMD_READ_SP;
  if (!ds.reset()) return fail("Mất presence (Read SP)");
  ds.select(rom);
  ds.write(CMD_READ_SP);
  for (uint8_t i = 1; i < sizeof(rs); i++) rs[i] = ds.read();
  crc[0] = ds.read();
  crc[1] = ds.read();
  if (!OneWire::check_crc16(rs, sizeof(rs), crc)) return fail("CRC16 sai (Read SP)");
  const uint8_t es = rs[3];
  if (rs[1] != ta1 || rs[2] != ta2) return fail("Địa chỉ scratchpad lệch");
  if ((es & 0xA7) != 0x07)          return fail("E/S bất thường");
  if (memcmp(rs + 4, data, 8) != 0) return fail("Scratchpad khác dữ liệu");

  if (!ds.reset()) return fail("Mất presence (Copy SP)");
  ds.select(rom);
  ds.write(CMD_COPY_SP);
  ds.write(ta1);
  ds.write(ta2);
  ds.write(es, 1);            // giữ strong pullup khi lập trình
  delay(T_PROG_MS);
  ds.depower();
  uint8_t st = ds.read();
  ds.reset();
  if (st == 0xFF) return fail("Chip không xác nhận copy");
  return true;
}

// DS2430A: ghi cả 32 byte: Write SP (0F) -> Read SP (AA, kiểm tra) -> Copy SP (55 + khóa A5).
// DS2430A không có CRC16 và không trả lời sau lệnh copy, nên việc kiểm tra cuối cùng là đọc lại EEPROM.
bool writePage2430A(const uint8_t *rom, const uint8_t *img) {
  static uint8_t sp[PAGE_2430A];

  if (!ds.reset()) return fail("Mất presence (Write SP)");
  ds.select(rom);
  ds.write(CMD_WRITE_SP);
  ds.write(0x00);                           // địa chỉ bắt đầu
  for (uint16_t i = 0; i < PAGE_2430A; i++) ds.write(img[i]);

  if (!ds.reset()) return fail("Mất presence (Read SP)");
  ds.select(rom);
  ds.write(CMD_READ_SP);
  ds.write(0x00);
  for (uint16_t i = 0; i < PAGE_2430A; i++) sp[i] = ds.read();
  if (memcmp(sp, img, PAGE_2430A) != 0) {
    ds.reset();
    return fail("Scratchpad khác dữ liệu");   // EEPROM chưa bị đổi
  }

  if (!ds.reset()) return fail("Mất presence (Copy SP)");
  ds.select(rom);
  ds.write(CMD_COPY_SP);
  ds.write(KEY_COPY_2430A, 1);              // validation key, rồi giữ strong pullup khi lập trình
  delay(T_PROG_MS);
  ds.depower();
  ds.reset();
  return true;
}

// Ghi 16 byte newData vào 0x00..0x0F của chip đã nhận diện. cur = nội dung chip vừa đọc (readStable).
bool writeUser16(ChipType t, const uint8_t *rom, const uint8_t *cur, const uint8_t *newData) {
  if (t == CT_28E07) {
    for (uint16_t off = 0; off < WRITE_LEN; off += 8)
      if (!writeRow(rom, WRITE_ADDR + off, newData + off)) return false;
    return true;
  }
  uint8_t img[PAGE_2430A];                  // DS2430A: giữ nguyên 0x10..0x1F, chỉ thay 0x00..0x0F
  memcpy(img, cur, PAGE_2430A);
  memcpy(img + WRITE_ADDR, newData, WRITE_LEN);
  return writePage2430A(rom, img);
}

// ================= CHỨC NĂNG 1: ĐỌC =================
void doRead() {
  drawScreen("ĐỌC THIẾT BỊ", "SEL: quay lại menu");
  txt(6, 60, "Đang đọc chip...", C_TEXT);

  uint8_t rom[8];
  if (!findChip(rom)) { showResult(false, "KHÔNG CÓ CHIP", g_err); waitAnyButton(); return; }
  ChipType ct = chipTypeOf(rom);
  if (ct == CT_NONE) {
    Serial.print("ROM ID : "); printHexLine(rom, 8); Serial.println();
    Serial.printf("[LỖI] Family code 0x%02X không hỗ trợ (chỉ 0x2D = DS28E07, 0x14 = DS2430A).\n", rom[0]);
    clearBody();
    drawRom(24, rom);
    txt(2, 48, "Chip không hỗ trợ", C_ERR);
    txt(2, 66, "Chỉ hỗ trợ 2D và 14", C_TEXT);
    waitAnyButton();
    return;
  }

  static uint8_t a[DUMP_LEN];
  if (!readStable(ct, rom, a)) { showResult(false, "ĐỌC LỖI", g_err); waitAnyButton(); return; }
  const uint16_t n = dumpLen(ct);

  uint8_t rev = 0xFF;
  bool revOk = (ct == CT_28E07) && readMemory(ct, rom, ADDR_REVISION, &rev, 1);

  // Lưu 16 byte vừa đọc làm MÃ CŨ (không lưu nếu đang là MÃ MỚI)
  bool saved = saveBackup(rom, a);

  // ---- Serial ----
  Serial.println("\n===== ĐỌC THIẾT BỊ =====");
  Serial.printf("Loại chip: %s\n", chipName(ct));
  Serial.print("ROM ID : "); printHexLine(rom, 8); Serial.println();
  Serial.printf("RAW (0x00..0x%02X): ", (unsigned)(n - 1)); printHexLine(a, n); Serial.println();

  // ---- TFT ----
  clearBody();
  drawRom(24, rom);
  drawHex16(2, 42, a, C_TEXT);

  char b[64];
  const uint16_t userEnd = (ct == CT_28E07) ? USER_LEN : n;   // hết vùng dữ liệu của từng loại chip
  bool rest00 = true, restFF = true;
  for (uint16_t i = WRITE_LEN; i < userEnd; i++) {
    if (a[i] != 0x00) rest00 = false;
    if (a[i] != 0xFF) restFF = false;
  }
  snprintf(b, sizeof(b), "0x10-0x%02X: %s", (unsigned)(userEnd - 1),
           rest00 ? "toàn 00" : (restFF ? "toàn FF" : "có dữ liệu"));
  txt(2, 78, b, C_DIM);

  if (ct == CT_28E07) {
    snprintf(b, sizeof(b), "P0:%02X %s  Rev:%02X", a[0x80], describeProtect(a[0x80]), revOk ? rev : 0xFF);
    txt(2, 94, b, a[0x80] == 0x00 ? C_OK : C_ERR);

    bool cp = (a[0x84] == 0x55 || a[0x84] == 0xAA);
    snprintf(b, sizeof(b), "Chống copy: %02X %s", a[0x84], cp ? "BẬT" : "tắt");
    txt(2, 110, b, C_TEXT);
  } else {
    txt(2, 94, "Không có khóa ghi", C_OK);
    txt(2, 110, "Bộ nhớ: 32 byte", C_TEXT);
  }

  snprintf(b, sizeof(b), "LOẠI CHIP: %s", chipName(ct));
  txt(2, 126, b, C_ACC);

  snprintf(b, sizeof(b), "NHẬN DIỆN: %s%s", nameOf(a), saved ? " [ĐÃ LƯU]" : "");
  txt(2, 140, b, strcmp(nameOf(a), "KHÁC") == 0 ? C_WARN : C_ACC);

  waitAnyButton();
}

// ================= XÁC NHẬN =================
// yesLbl: nhãn nút bên phải (GHI / LƯU / XÓA)
void drawChoice(bool yes, const char *yesLbl) {
  fillR(0, 128, SCR_W, 30, C_BG);
  // HỦY
  if (!yes) fillR(10, 130, 90, 24, C_ERR);
  else      strokeR(10, 130, 90, 24, C_ERR);
  txt(43, 134, "HỦY", yes ? C_TEXT : C_WHITE);
  // GHI / LƯU / XÓA
  if (yes)  fillR(120, 130, 90, 24, C_OK);
  else      strokeR(120, 130, 90, 24, C_OK);
  txt(153, 134, yesLbl, yes ? C_WHITE : C_TEXT);
}

bool confirmWrite(const char *yesLbl = "GHI") {
  bool yes = false;                      // mặc định là HỦY cho an toàn
  drawChoice(yes, yesLbl);
  while (true) {
    Event e = pollButtons();
    if (e == EV_NEXT) { yes = !yes; drawChoice(yes, yesLbl); }
    else if (e == EV_SELECT) return yes;
    delay(5);
  }
}

// ================= CHỨC NĂNG 2 + 3 + 4: GHI =================
// baseData   : dữ liệu nền để ghi (bị bỏ qua khi restore = true)
// randomLast : true = byte cuối của dữ liệu ghi là số ngẫu nhiên (GHI MÃ MỚI RANDOM)
// restore    : true = ghi lại MÃ CŨ đã lưu (chỉ khi ROM ID khớp chip đã backup)
void runWrite(const uint8_t *baseData, const char *title, const char *label,
              bool randomLast, bool restore) {
  drawScreen(title, "NAV: đổi   SEL: chọn");
  txt(6, 60, "Đang kiểm tra chip...", C_TEXT);

  uint8_t rom[8];
  ChipType ct;
  if (!findSupported(rom, ct)) return;

  if (restore) {
    if (!g_hasBk) {
      showResult(false, "CHƯA CÓ MÃ CŨ", "Hãy ĐỌC chip gốc trước");
      waitAnyButton(); return;
    }
    if (memcmp(rom, g_bkRom, 8) != 0) {
      showResult(false, "SAI CHIP", "Khác chip đã backup");
      waitAnyButton(); return;
    }
    baseData = g_bkData;
  }

  static uint8_t cur[DUMP_LEN];
  if (!readStable(ct, rom, cur)) { showResult(false, "ĐỌC LỖI", g_err); waitAnyButton(); return; }

  if (ct == CT_28E07 && (cur[0x80] == 0x55 || cur[0x80] == 0xAA)) {
    showResult(false, "PAGE 0 BỊ KHÓA", describeProtect(cur[0x80]));
    waitAnyButton(); return;
  }

  // Tạo dữ liệu sẽ ghi; nếu randomLast thì byte cuối là ngẫu nhiên
  uint8_t newData[WRITE_LEN];
  memcpy(newData, baseData, WRITE_LEN);
  if (randomLast) {
    do {
      newData[WRITE_LEN - 1] = (uint8_t)(esp_random() & 0xFF);
    } while (memcmp(newData, cur, WRITE_LEN) == 0);   // tránh trùng đúng dữ liệu hiện tại
  }

  if (memcmp(cur, newData, WRITE_LEN) == 0) {
    showResult(true, "ĐÃ GIỐNG", "Không cần ghi lại");
    waitAnyButton(); return;
  }

  // Backup ra Serial
  Serial.printf("\n===== %s =====\n", title);
  Serial.printf("Loại chip        : %s\n", chipName(ct));
  Serial.print("Chip ROM         : "); printHexLine(rom, 8); Serial.println();
  Serial.print("BACKUP (hiện tại): "); printHexLine(cur, WRITE_LEN); Serial.println();
  Serial.print("SẼ GHI           : "); printHexLine(newData, WRITE_LEN); Serial.println();

  // Màn hình xác nhận
  clearBody();
  char b[64];
  snprintf(b, sizeof(b), "Hiện tại (%s):", nameOf(cur));
  txt(2, 24, b, C_DIM);
  drawHex16(2, 40, cur, C_TEXT);
  snprintf(b, sizeof(b), "Sẽ ghi (%s):", label);
  txt(2, 76, b, C_WARN);
  drawHex16(2, 92, newData, C_WARN);

  if (!confirmWrite("GHI")) {
    showResult(false, "ĐÃ HỦY", "Không ghi gì cả");
    waitAnyButton(); return;
  }

  // Ghi mã mới: lưu mã hiện tại (vừa đọc từ chip) làm MÃ CŨ trước khi ghi đè.
  // (Không lưu đè nếu chip đang là MÃ MỚI; khôi phục thì giữ nguyên backup.)
  if (!restore) saveBackup(rom, cur);

  // Ghi
  clearBody();
  txtS(6, 50, "ĐANG GHI...", C_WARN, 2);
  txt(6, 90, "Giữ chip chắc, đừng rút!", C_TEXT);

  if (!writeUser16(ct, rom, cur, newData)) {
    Serial.println("GHI LỖI. Backup nằm ở dòng trên.");
    showResult(false, "GHI LỖI", g_err);
    waitAnyButton(); return;
  }

  // Kiểm tra: 16 byte vừa ghi khớp, phần còn lại (0x10.. và admin) không đổi
  static uint8_t after[DUMP_LEN];
  if (!readStable(ct, rom, after)) { showResult(false, "ĐỌC LẠI LỖI", g_err); waitAnyButton(); return; }
  const uint16_t n = dumpLen(ct);
  bool dataOk = (memcmp(after, newData, WRITE_LEN) == 0);
  bool restOk = (memcmp(after + WRITE_LEN, cur + WRITE_LEN, n - WRITE_LEN) == 0);

  Serial.print("RAW sau khi ghi: "); printHexLine(after, n); Serial.println();
  Serial.printf("16 byte: %s | Vùng còn lại + admin: %s\n",
                dataOk ? "KHỚP" : "KHÔNG KHỚP", restOk ? "không đổi" : "BỊ ĐỔI!");

  if (dataOk && restOk) {
    showResult(true, "THÀNH CÔNG", label);
    drawHex16(8, 96, after, C_OK);
  } else {
    showResult(false, "CHƯA ĐÚNG", dataOk ? "Vùng khác bị đổi" : "Dữ liệu không khớp");
  }
  waitAnyButton();
}

// ================= DANH SÁCH THIẾT BỊ: chọn / thêm / xóa =================
constexpr int LIST_VIS = 5;
constexpr int LIST_Y0  = 26;
constexpr int LIST_RH  = 22;

// mgr = true : [0]="+ Thêm", [1..n]=thiết bị, [n+1]="Quay lại"
// mgr = false: [0..n-1]=thiết bị, [n]="Quay lại"
int listTotal(bool mgr) { return g_nDev + (mgr ? 1 : 0) + 1; }

void listLabel(int i, bool mgr, char *b, size_t sz) {
  if (mgr && i == 0) { snprintf(b, sz, "+ Thêm thiết bị mới"); return; }
  int d = i - (mgr ? 1 : 0);
  if (d >= g_nDev)   { snprintf(b, sz, "Quay lại"); return; }
  const uint8_t *p = g_dev[d];
  snprintf(b, sz, "%d: %02X%02X%02X%02X%02X%02X%02X%02X",
           d + 1, p[0], p[1], p[2], p[3], p[4], p[5], p[6], p[7]);
}

void drawListRows(int sel, int top, bool mgr) {
  int total = listTotal(mgr);
  char b[40];
  for (int s = 0; s < LIST_VIS; s++) {
    int i = top + s;
    int y = LIST_Y0 + s * LIST_RH;
    if (i >= total) { fillR(4, y, SCR_W - 8, 20, C_BG); continue; }
    listLabel(i, mgr, b, sizeof(b));
    if (i == sel) {
      fillR(4, y, SCR_W - 8, 20, C_SEL);
    } else {
      fillR(4, y, SCR_W - 8, 20, C_BG);
      strokeR(4, y, SCR_W - 8, 20, C_DIM);
    }
    txt(12, y + 2, b, C_TEXT);
  }
}

// Trả về chỉ số mục được chọn (theo quy ước ở trên)
int menuList(const char *title, bool mgr) {
  drawScreen(title, "NAV: xuống   SEL: chọn");
  int total = listTotal(mgr), sel = 0, top = 0;
  drawListRows(sel, top, mgr);
  while (true) {
    Event e = pollButtons();
    if (e == EV_NEXT) {
      sel = (sel + 1) % total;
      if (sel < top) top = sel;
      else if (sel >= top + LIST_VIS) top = sel - LIST_VIS + 1;
      drawListRows(sel, top, mgr);
    } else if (e == EV_SELECT) {
      return sel;
    }
    delay(5);
  }
}

// Chọn thiết bị mã mới để ghi. Trả về chỉ số thiết bị, hoặc -1 nếu quay lại / chưa có
int pickDevice(const char *title) {
  if (g_nDev == 0) {
    drawScreen(title, "SEL: quay lại");
    showResult(false, "Chưa có mã mới", "Hãy thêm ở mục 5");
    waitAnyButton();
    return -1;
  }
  int s = menuList(title, false);
  return (s < g_nDev) ? s : -1;
}

// Thêm thiết bị mới: đọc 16 byte từ chip đang cắm (DS28E07 hoặc DS2430A)
void doAddDevice() {
  drawScreen("ĐỌC MÃ MỚI", "SEL: quay lại menu");
  txt(6, 60, "Đang đọc chip...", C_TEXT);

  if (g_nDev >= MAX_DEV) {
    showResult(false, "Danh sách đầy", "Hãy xóa bớt thiết bị");
    waitAnyButton(); return;
  }

  uint8_t rom[8];
  ChipType ct;
  if (!findSupported(rom, ct)) return;

  static uint8_t cur[DUMP_LEN];
  if (!readStable(ct, rom, cur)) { showResult(false, "ĐỌC LỖI", g_err); waitAnyButton(); return; }

  int dup = findNewIdx(cur);
  if (dup >= 0) {
    char b[32];
    snprintf(b, sizeof(b), "Trùng thiết bị số %d", dup + 1);
    showResult(false, "Đã có rồi", b);
    waitAnyButton(); return;
  }

  clearBody();
  char b[48];
  txt(2, 24, "Dữ liệu chip hiện tại:", C_DIM);
  drawHex16(2, 40, cur, C_TEXT);
  snprintf(b, sizeof(b), "Lưu làm TB số %d?", g_nDev + 1);
  txt(2, 82, b, C_WARN);
  txt(2, 100, "Byte cuối sẽ random khi ghi", C_DIM);

  if (!confirmWrite("LƯU")) {
    showResult(false, "ĐÃ HỦY", "Không lưu gì cả");
    waitAnyButton(); return;
  }

  memcpy(g_dev[g_nDev], cur, WRITE_LEN);
  g_nDev++;
  saveDevices();

  // Nếu 16 byte này lỡ bị lưu làm MÃ CŨ trước đó thì hủy backup đó
  if (g_hasBk && memcmp(g_bkData, cur, WRITE_LEN - 1) == 0) {
    g_hasBk = false;
    prefs.remove("bkdat");
    prefs.remove("bkrom");
  }

  Serial.printf("Đã thêm thiết bị mới số %d (%s): ", g_nDev, chipName(ct));
  printHexLine(cur, WRITE_LEN); Serial.println();
  snprintf(b, sizeof(b), "Thiết bị số %d", g_nDev);
  showResult(true, "ĐÃ LƯU", b);
  waitAnyButton();
}

void doDeleteDevice(int d) {
  drawScreen("XÓA MÃ MỚI", "NAV: đổi   SEL: chọn");
  char b[40];
  snprintf(b, sizeof(b), "Xóa thiết bị số %d?", d + 1);
  txt(2, 24, b, C_WARN);
  drawHex16(2, 44, g_dev[d], C_TEXT);

  if (!confirmWrite("XÓA")) return;

  for (int i = d; i < g_nDev - 1; i++) memcpy(g_dev[i], g_dev[i + 1], WRITE_LEN);
  g_nDev--;
  saveDevices();
  showResult(true, "ĐÃ XÓA", "Đã cập nhật danh sách");
  waitAnyButton();
}

// Màn hình quản lý danh sách (menu mục 5)
void runDevices() {
  while (true) {
    int s = menuList("THIẾT BỊ MỚI", true);
    if (s == 0)                 doAddDevice();
    else if (s >= 1 + g_nDev)   return;              // Quay lại
    else                        doDeleteDevice(s - 1);
  }
}

// ================= CHỨC NĂNG 6: CÀI ĐẶT MÀN HÌNH =================
constexpr int SET_N = 5;

void drawSettingRow(int i, int sel) {
  char b[48];
  switch (i) {
    case 0: snprintf(b, sizeof(b), "HƯỚNG: %d", g_orient); break;
    case 1: snprintf(b, sizeof(b), "LẬT DỌC: %s", g_flipY ? "BẬT" : "TẮT"); break;
    case 2: snprintf(b, sizeof(b), "LẬT NGANG: %s", g_flipX ? "BẬT" : "TẮT"); break;
    case 3: snprintf(b, sizeof(b), "ĐẢO MÀU: %s", g_inv ? "BẬT" : "TẮT"); break;
    default: snprintf(b, sizeof(b), "LƯU VÀ THOÁT"); break;
  }
  int y = 26 + i * 26;
  if (i == sel) {
    fillR(4, y, SCR_W - 8, 22, C_SEL);
  } else {
    fillR(4, y, SCR_W - 8, 22, C_BG);
    strokeR(4, y, SCR_W - 8, 22, C_DIM);
  }
  txt(12, y + 3, b, C_TEXT);
}

void drawSettings(int sel) {
  drawScreen("CÀI ĐẶT MÀN HÌNH", "NAV: xuống   SEL: đổi");
  for (int i = 0; i < SET_N; i++) drawSettingRow(i, sel);
}

void runSettings() {
  int sel = 0;
  applyDisplay();
  drawSettings(sel);
  while (true) {
    Event e = pollButtons();
    if (e == EV_NEXT) {
      int old = sel;
      sel = (sel + 1) % SET_N;
      drawSettingRow(old, sel);
      drawSettingRow(sel, sel);
    } else if (e == EV_SELECT) {
      switch (sel) {
        case 0: g_orient = (g_orient == 1) ? 3 : 1; applyDisplay(); break;
        case 1: g_flipY = !g_flipY; break;
        case 2: g_flipX = !g_flipX; break;
        case 3: g_inv = !g_inv; applyDisplay(); break;
        default: saveSettings(); return;
      }
      drawSettings(sel);
    }
    delay(5);
  }
}

// ================= MENU =================
const char *MENU_ITEMS[] = {
  "1. ĐỌC THIẾT BỊ",
  "2. GHI MÃ MỚI",
  "3. GHI MÃ MỚI RANDOM",
  "4. KHÔI PHỤC MÃ CŨ",
  "5. THIẾT BỊ MỚI",
  "6. CÀI ĐẶT"
};
constexpr int MENU_N = sizeof(MENU_ITEMS) / sizeof(MENU_ITEMS[0]);
int menuSel = 0;

void drawMenuItem(int i) {
  int y = 24 + i * 22;                    // 6 mục x 22px, mỗi ô cao 20px
  if (i == menuSel) {
    fillR(4, y, SCR_W - 8, 20, C_SEL);
  } else {
    fillR(4, y, SCR_W - 8, 20, C_BG);
    strokeR(4, y, SCR_W - 8, 20, C_DIM);
  }
  txt(12, y + 2, MENU_ITEMS[i], C_TEXT);
}

void drawMenu() {
  drawScreen("DS28E07 / DS2430A", "NAV: xuống   SEL: chọn");
  for (int i = 0; i < MENU_N; i++) drawMenuItem(i);
}

// ================= LOGO KHỞI ĐỘNG "TUIOT" (đúng 3 giây) =================
// Dòng thời gian (tính theo millis, nên luôn xong ~3000ms dù SPI nhanh hay chậm):
//    0 -  400 ms : màn hình bật kiểu CRT (đường sáng ngang -> mở ra toàn màn hình)
//  400 - 1500 ms : 5 chữ T-U-I-O-T rơi từ trên xuống, nảy khi chạm đất, sáng trắng rồi lên màu
// 1500 - 2100 ms : 4 góc khung hiện ra, gạch chân sáng mở rộng từ giữa, dòng phụ gõ từng chữ
// 2100 - 2800 ms : ánh sáng quét qua từng chữ (shine)
// 2800 - 3000 ms : màn hình tắt kiểu CRT (khép từ trên và dưới vào giữa)
constexpr uint16_t rgb565(uint8_t r, uint8_t g, uint8_t b) {
  return (uint16_t)(((r & 0xF8) << 8) | ((g & 0xFC) << 3) | (b >> 3));
}

constexpr int SP_N    = 5;                       // số chữ trong "TUIOT"
constexpr int SP_SC   = 4;                       // phóng to x4 -> mỗi chữ 32x64
constexpr int SP_GW   = 8 * SP_SC;
constexpr int SP_GH   = 16 * SP_SC;
constexpr int SP_GAP  = 10;                      // khoảng cách giữa các chữ
constexpr int LINE_W  = SP_N * SP_GW + (SP_N - 1) * SP_GAP;   // 200
constexpr int SP_X0   = (SCR_W - LINE_W) / 2;
constexpr int SP_Y    = 30;                      // vị trí cuối của hàng chữ
constexpr int SP_LINE_Y = 98;                    // gạch chân
constexpr int SP_SUB_Y  = 110;                   // dòng phụ

constexpr uint32_t SP_TB = 400, SP_TC = 1500, SP_TD = 2100, SP_TE = 2800, SP_TOTAL = 3000;

constexpr uint16_t SP_BG    = rgb565(5, 10, 32);            // xanh navy đậm
constexpr uint16_t SP_LINE  = rgb565(190, 240, 255);
constexpr uint16_t SP_SUB   = rgb565(150, 175, 210);
constexpr uint16_t SP_FLASH = rgb565(255, 255, 255);
constexpr uint16_t SP_COL[SP_N] = {                         // dải màu cyan -> tím
  rgb565(0, 229, 255), rgb565(40, 180, 255), rgb565(90, 130, 255),
  rgb565(150, 90, 255), rgb565(210, 70, 230)
};

const char SP_TXT[]    = "TUIOT";
const char SP_SUBTXT[] = "DS28E07 / DS2430A";

float bounceOut(float t) {                       // hiệu ứng nảy khi chạm đất
  if (t < 1.0f / 2.75f) return 7.5625f * t * t;
  if (t < 2.0f / 2.75f) { t -= 1.5f / 2.75f;   return 7.5625f * t * t + 0.75f; }
  if (t < 2.5f / 2.75f) { t -= 2.25f / 2.75f;  return 7.5625f * t * t + 0.9375f; }
  t -= 2.625f / 2.75f;
  return 7.5625f * t * t + 0.984375f;
}

// Vẽ ký tự "đặc" (có cả màu nền) và cắt theo mép trên/dưới màn hình -> di chuyển không bị nháy
void splashGlyph(int x, int y, const uint8_t *g, uint16_t fg, uint16_t bg) {
  for (int r = 0; r < 16; r++) {
    int py = y + r * SP_SC;
    if (py < 0 || py + SP_SC > SCR_H) continue;
    uint8_t b = g[r];
    int c = 0;
    while (c < 8) {
      bool on = (b & (0x80 >> c)) != 0;
      int st = c;
      while (c < 8 && ((b & (0x80 >> c)) != 0) == on) c++;
      fillR(x + st * SP_SC, py, (c - st) * SP_SC, SP_SC, on ? fg : bg);
    }
  }
}

// Xoá dải ngang [y0, y1) bề rộng 1 chữ (phần ký tự cũ không còn bị ký tự mới che)
void splashErase(int x, int y0, int y1) {
  if (y0 < 0) y0 = 0;
  if (y1 > SCR_H) y1 = SCR_H;
  if (y1 > y0) fillR(x, y0, SP_GW, y1 - y0, SP_BG);
}

void splashLetter(int i, int y, uint16_t col) {
  splashGlyph(SP_X0 + i * (SP_GW + SP_GAP), y, vnGlyph(SP_TXT[i]), col, SP_BG);
}

void splashCorners(uint16_t c) {                 // 4 góc khung
  const int m = 4, L = 14, T = 2;
  fillR(m, m, L, T, c);                          fillR(m, m, T, L, c);
  fillR(SCR_W - m - L, m, L, T, c);              fillR(SCR_W - m - T, m, T, L, c);
  fillR(m, SCR_H - m - T, L, T, c);              fillR(m, SCR_H - m - L, T, L, c);
  fillR(SCR_W - m - L, SCR_H - m - T, L, T, c);  fillR(SCR_W - m - T, SCR_H - m - L, T, L, c);
}

void showSplash() {
  const uint32_t t0 = millis();
  uint32_t t;

  // ---------- A. Bật màn hình kiểu CRT ----------
  fillR(0, 0, SCR_W, SCR_H, 0x0000);
  const int cy = SCR_H / 2;
  int lw = 0;
  while ((t = millis() - t0) < 150) {            // đường sáng ngang mở rộng từ giữa
    int w = (int)(SCR_W * t / 150);
    if (w > lw) { fillR((SCR_W - w) / 2, cy - 1, w, 2, SP_LINE); lw = w; }
  }
  fillR(0, cy - 1, SCR_W, 2, SP_LINE);

  int pTop = cy - 1, pH = 2;                     // vùng đã mở (viền trên/dưới là đường sáng)
  while ((t = millis() - t0) < SP_TB) {          // mở theo chiều dọc
    int h = 2 + (int)((SCR_H - 2) * (t - 150) / (SP_TB - 150));
    h &= ~1;
    if (h > pH && h <= SCR_H) {
      int top = (SCR_H - h) / 2;
      fillR(0, pTop, SCR_W, 1, SP_BG);                       // xoá viền cũ
      fillR(0, pTop + pH - 1, SCR_W, 1, SP_BG);
      fillR(0, top, SCR_W, pTop - top, SP_BG);               // dải mới phía trên
      fillR(0, pTop + pH, SCR_W, (top + h) - (pTop + pH), SP_BG);   // dải mới phía dưới
      fillR(0, top, SCR_W, 1, SP_LINE);                      // viền sáng mới
      fillR(0, top + h - 1, SCR_W, 1, SP_LINE);
      pTop = top; pH = h;
    }
  }
  fillR(0, 0, SCR_W, SCR_H, SP_BG);

  // ---------- B. Các chữ rơi xuống và nảy ----------
  int  cyL[SP_N];
  bool settled[SP_N];
  for (int i = 0; i < SP_N; i++) { cyL[i] = -SP_GH; settled[i] = false; }
  const uint32_t STAG = 150, DUR = 500;
  const uint32_t endB = SP_TB + (SP_N - 1) * STAG + DUR;     // = SP_TC
  while (true) {
    t = millis() - t0;
    for (int i = 0; i < SP_N; i++) {
      uint32_t st = SP_TB + i * STAG;
      if (t < st) continue;
      float p = (float)(t - st) / (float)DUR;
      if (p > 1.0f) p = 1.0f;
      bool fin = (p >= 1.0f);
      int ny = fin ? SP_Y : (-SP_GH) + (int)((SP_Y + SP_GH) * bounceOut(p));
      if (ny == cyL[i] && (!fin || settled[i])) continue;
      int x = SP_X0 + i * (SP_GW + SP_GAP);
      if (ny > cyL[i]) splashErase(x, cyL[i], (ny < cyL[i] + SP_GH) ? ny : cyL[i] + SP_GH);
      else             splashErase(x, (ny + SP_GH > cyL[i]) ? ny + SP_GH : cyL[i], cyL[i] + SP_GH);
      splashLetter(i, ny, fin ? SP_COL[i] : SP_FLASH);       // đang rơi = trắng, chạm đất = lên màu
      cyL[i] = ny;
      if (fin) settled[i] = true;
    }
    if (t >= endB) break;
  }

  // ---------- C. Khung góc + gạch chân + dòng phụ gõ từng chữ ----------
  splashCorners(SP_COL[0]);
  const int subLen = (int)(sizeof(SP_SUBTXT) - 1);
  const int subX = (SCR_W - subLen * 8) / 2;
  int lineW = 0, shown = 0;
  while ((t = millis() - t0) < SP_TD) {
    float p = (float)(t - SP_TC) / 350.0f;
    if (p > 1.0f) p = 1.0f;
    p = 1.0f - (1.0f - p) * (1.0f - p);                      // ease-out
    int w = (int)(LINE_W * p);
    if (w > lineW) { fillR(SP_X0 + (LINE_W - w) / 2, SP_LINE_Y, w, 3, SP_LINE); lineW = w; }
    int n = (t > SP_TC + 200) ? (int)((t - SP_TC - 200) / 30) : 0;
    if (n > subLen) n = subLen;
    while (shown < n) {
      char s[2] = { SP_SUBTXT[shown], 0 };
      txt(subX + shown * 8, SP_SUB_Y, s, SP_SUB);
      shown++;
    }
  }
  if (lineW < LINE_W) fillR(SP_X0, SP_LINE_Y, LINE_W, 3, SP_LINE);
  txt(subX, SP_SUB_Y, SP_SUBTXT, SP_SUB);                    // đảm bảo đủ cả dòng

  // ---------- D. Ánh sáng quét qua các chữ, E. Tắt kiểu CRT ----------
  int shineLast = -2;
  int closed = 0;
  while ((t = millis() - t0) < SP_TOTAL) {
    if (t < SP_TE) {
      int pos = (int)(((t - SP_TD) / 70) % 7);               // 0..4 = chữ đang sáng, 5..6 = nghỉ
      int hl = (pos < SP_N) ? pos : -1;
      if (hl != shineLast) {
        if (shineLast >= 0) splashLetter(shineLast, SP_Y, SP_COL[shineLast]);
        if (hl >= 0)        splashLetter(hl, SP_Y, SP_FLASH);
        shineLast = hl;
      }
    } else {
      float p = (float)(t - SP_TE) / (float)(SP_TOTAL - SP_TE);
      int c = (int)((SCR_H / 2) * p);                        // khép từ trên và dưới vào giữa
      if (c > closed) {
        fillR(0, closed, SCR_W, c - closed, 0x0000);
        fillR(0, SCR_H - c, SCR_W, c - closed, 0x0000);
        closed = c;
      }
    }
  }
}

// ================= ARDUINO =================
void setup() {
  Serial.begin(115200);

  pinMode(PIN_NAV, INPUT_PULLUP);
  pinMode(PIN_SEL, INPUT_PULLUP);

  loadSettings();
  loadBackup();
  loadDevices();
  if (digitalRead(PIN_SEL) == LOW) {          // giữ SEL lúc cấp nguồn = reset cài đặt màn hình
    g_orient = 1; g_flipX = false; g_flipY = true; g_inv = false;
    saveSettings();
    Serial.println("Đã khôi phục cài đặt màn hình mặc định");
  }

  SPI.begin(PIN_TFT_SCK, -1, PIN_TFT_SDI, PIN_TFT_CS);
  tft.begin();
  applyDisplay();
  showSplash();                               // logo TUIOT 3 giây

  Serial.println("\nDS28E07 + DS2430A menu tool - ESP32-S3 / ILI9225");
  Serial.printf("Số thiết bị mã mới: %d\n", g_nDev);
  if (g_hasBk) {
    Serial.print("MÃ CŨ đã lưu (ROM "); printHexLine(g_bkRom, 8);
    Serial.print("): "); printHexLine(g_bkData, WRITE_LEN); Serial.println();
  }
  drawMenu();
}

void loop() {
  Event e = pollButtons();
  if (e == EV_NEXT) {
    int old = menuSel;
    menuSel = (menuSel + 1) % MENU_N;
    drawMenuItem(old);
    drawMenuItem(menuSel);
  } else if (e == EV_SELECT) {
    switch (menuSel) {
      case 0: doRead(); break;
      case 1: {                                   // GHI MÃ MỚI: chọn thiết bị rồi ghi đúng mã
        int d = pickDevice("CHỌN MÃ MỚI");
        if (d >= 0) {
          char lb[24];
          snprintf(lb, sizeof(lb), "MÃ MỚI %d", d + 1);
          runWrite(g_dev[d], "GHI MÃ MỚI", lb, false, false);
        }
        break;
      }
      case 2: {                                   // GHI MÃ MỚI RANDOM: byte cuối random
        int d = pickDevice("CHỌN MÃ MỚI");
        if (d >= 0) {
          char lb[24];
          snprintf(lb, sizeof(lb), "MÃ MỚI %d RANDOM", d + 1);
          runWrite(g_dev[d], "GHI MÃ MỚI RANDOM", lb, true, false);
        }
        break;
      }
      case 3: runWrite(nullptr, "KHÔI PHỤC MÃ CŨ", "MÃ CŨ", false, true); break;   // ghi lại mã đã đọc/lưu
      case 4: runDevices(); break;
      case 5: runSettings(); break;
    }
    drawMenu();
  }
  delay(5);
}